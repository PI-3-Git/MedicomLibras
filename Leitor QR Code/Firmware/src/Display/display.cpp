#include <Arduino.h>
#include <Adafruit_SSD1306.h>
#include <U8g2_for_Adafruit_GFX.h>
#include <Wire.h>

#include "display.h"

#define DISPLAY_WIDTH 128 // Largura do display em pixels
#define DISPLAY_HEIGHT 64 // Altura do display em pixels
#define DISPLAY_RESET_PIN -1 //-1 para não uso de pino de reset
#define DISPLAY_ADDRESS 0x3C //Endereço I2C do display

//Construtores
Adafruit_SSD1306 display(DISPLAY_WIDTH, DISPLAY_HEIGHT, &Wire, DISPLAY_RESET_PIN);
U8G2_FOR_ADAFRUIT_GFX u8g2;

//Construtor da classe
Display::Display(void){
    
}

int displayFontH = 1;
int displayLines[]{26, 41, 56, 71};

//Ícone MedicomLibras

const unsigned char medicomlibrasIcon [] PROGMEM = {
	// 'medicomlibras', 48x48px
    0x00, 0x03, 0xff, 0xff, 0x80, 0x00, 0x00, 0x03, 0xff, 0xff, 0x80, 0x00, 0x00, 0x02, 0x00, 0x00, 
	0x00, 0x00, 0x00, 0x02, 0x00, 0x00, 0x00, 0x00, 0x00, 0x02, 0x00, 0x00, 0x00, 0x00, 0x00, 0x02, 
	0x00, 0x00, 0x00, 0x00, 0x00, 0x02, 0x00, 0x00, 0x00, 0x00, 0x00, 0x02, 0x00, 0x00, 0x00, 0x00, 
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	0x00, 0x00, 0xc0, 0x00, 0x00, 0x01, 0xff, 0xff, 0xc0, 0x00, 0x00, 0x01, 0xff, 0xff, 0xc0, 0x00
};


void Display::displayInit(void){
    Wire.begin(SDA, SCL);
    if(!display.begin(SSD1306_SWITCHCAPVCC, DISPLAY_ADDRESS)) {
        Serial.println(F("Falha na alocação do display"));
    }
    u8g2.begin(display);
    display.clearDisplay();
    displayLogo();
    delay(5000);
    display.display();
}

void Display::statusBar(int wifiConn, bool qrCodeRead, char* dia, char* hora){
    display.fillRect(0, 0, 128, 16, SSD1306_BLACK);//apaga a área da barra de status
    display.setTextColor(SSD1306_BLACK);
    //exibe intensidade do sinal wifi
    u8g2.setFont(u8g2_font_siji_t_6x10);
    int y = ( 16 - ( u8g2.getFontAscent() - u8g2.getFontDescent() ) ) / 2; //centraliza a fonte
    //intensidade do sinal wifi
    if (wifiConn > 66) {       
        u8g2.drawGlyph(0, 10, 0x0e04b);
    }
    else if (wifiConn > 33 && wifiConn <= 66) {
        u8g2.drawGlyph(0, 10, 0x0e04a);
    }
    else {
        u8g2.drawGlyph(0, 10, 0x0e049);
    }
    //relógio
    std::string relogioStr = std::string(dia) + " - " + std::string(hora);
    const char* relogio = relogioStr.c_str();
    u8g2.setFont(u8g2_font_rosencrantz_nbp_tr);
    y = ( 16 - ( u8g2.getFontAscent() - u8g2.getFontDescent() ) ) / 2; //centraliza a fonte
    u8g2.setCursor( 127 - u8g2.getUTF8Width(relogio), 12 );//posicionando o relógio à direita do display
    u8g2.println(relogio);
    display.display();
}

void Display::displayPrint(char* text, int line) {
    display.fillRect(0, 16, 128, 48, SSD1306_BLACK);//apaga a área de escrita
    u8g2.setFont(u8g2_font_mercutio_basic_nbp_tf);
    int y_offset = displayLines[line];
    int current_x = 0;
    char *token;
    char *rest = text;

    while ((token = strtok_r(rest, " ", &rest)) != NULL) {
        int token_width = u8g2.getUTF8Width(token);
        int space_width = (rest != NULL && rest[0] != '\0') ? u8g2.getUTF8Width(" ") : 0; // Largura do espaço seguinte
        if (current_x + token_width <= 128) {
            u8g2.setCursor(current_x, y_offset);
            u8g2.print(token);
            current_x += token_width + space_width;
        } else {
            // Avança para a próxima linha
            line++;
            if (line >= sizeof(displayLines) / sizeof(displayLines[0])) {
                break; // Para evitar escrever fora das linhas definidas
            }
            y_offset = displayLines[line];
            current_x = 0;
            u8g2.setCursor(current_x, y_offset);
            u8g2.print(token);
            current_x += token_width + space_width;
        }
    }
    display.display();
}

void Display::displayLogo(void){
    display.fillRect(0, 16, 128, 48, SSD1306_BLACK);//apaga a área de escrita
    display.drawBitmap(( DISPLAY_WIDTH - 48 ) / 2, 16, medicomlibrasIcon, 48, 48, SSD1306_WHITE);
    display.display();
}

void Display::displayProgressBar(unsigned int progress){
    float progresspc = (float)(progress) / 100;
    int barra = (127) * progresspc;

    display.drawRect(0, 50, 128, 14, SSD1306_WHITE);
    display.fillRect(0, 50, barra, 14, SSD1306_WHITE);
    display.display();
}



